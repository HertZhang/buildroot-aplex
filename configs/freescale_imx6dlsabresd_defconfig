## configs/freescale_imx6dlsabresd_defconfig
```kconfig
BR2_arm=y
BR2_cortex_a9=y
BR2_JLEVEL=10
BR2_TOOLCHAIN_EXTERNAL=y
BR2_TARGET_GENERIC_HOSTNAME="aplex"
BR2_TARGET_GENERIC_ISSUE="Welcome to aplex!"
BR2_ROOTFS_DEVICE_CREATION_DYNAMIC_EUDEV=y
BR2_TARGET_GENERIC_ROOT_PASSWD="root"
BR2_LINUX_KERNEL=y
BR2_LINUX_KERNEL_CUSTOM_GIT=y
BR2_LINUX_KERNEL_CUSTOM_REPO_URL="https://github.com/ZengjfOS/Buildroot.git"
BR2_LINUX_KERNEL_CUSTOM_REPO_VERSION="fsl_kernel_L4.1.15_from_TP"
BR2_LINUX_KERNEL_USE_CUSTOM_CONFIG=y
BR2_LINUX_KERNEL_CUSTOM_CONFIG_FILE="/home/desk/buildroot/buildroot-2018.02/output/build/linux-fsl_kernel_L4.1.15_from_TP/arch/arm/configs/imx_v7_defconfig"
BR2_LINUX_KERNEL_DTS_SUPPORT=y
BR2_LINUX_KERNEL_INTREE_DTS_NAME="imx6dl-sabresd"
BR2_TARGET_ROOTFS_TAR_BZIP2=y
BR2_TARGET_UBOOT=y
BR2_TARGET_UBOOT_BUILD_SYSTEM_KCONFIG=y
BR2_TARGET_UBOOT_CUSTOM_GIT=y
BR2_TARGET_UBOOT_CUSTOM_REPO_URL="https://github.com/ZengjfOS/Buildroot.git"
BR2_TARGET_UBOOT_CUSTOM_REPO_VERSION="fsl_uboot_L4.1.15_from_TP"
BR2_TARGET_UBOOT_BOARD_DEFCONFIG="mx6dlsabresd"
BR2_TARGET_UBOOT_FORMAT_IMX=y
```
